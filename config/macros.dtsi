macro_rightbottom: macro_rightbottom{
compatible = "zmk,behavior-macro";
label = "macro_rightbottom";
#binding-cells = <0>;
bindings = <&macro_press   &kp LGUI &kp LEFT_SHIFT>,
           <&macro_press   &kp RCTRL>,
           <&kp RIGHT_ARROW>,
           <&macro_release &kp RCTRL>,
           <&macro_release &kp LGUI &kp LEFT_SHIFT &kp RCTRL>;
};
macro_righttop: macro_righttop{
compatible = "zmk,behavior-macro";
label = "macro_righttop";
#binding-cells = <0>;
bindings = <&macro_press   &kp LGUI &kp RCTRL>,
           <&kp RIGHT_ARROW>,
           <&macro_release &kp LGUI &kp RCTRL>;
};
macro_leftbottom: macro_leftbottom{
compatible = "zmk,behavior-macro";
label = "macro_leftbottom";
#binding-cells = <0>;
bindings = <&macro_press   &kp LGUI &kp LEFT_SHIFT>,
           <&macro_press   &kp RCTRL>,
           <&kp LEFT_ARROW>,
           <&macro_release &kp RCTRL>,
           <&macro_release &kp LGUI &kp LEFT_SHIFT>;
};
macro_lefttop: macro_lefttop{
compatible = "zmk,behavior-macro";
label = "macro_lefttop";
#binding-cells = <0>;
bindings = <&macro_press   &kp LGUI &kp RCTRL>,
           <&kp LEFT_ARROW>,
           <&macro_release &kp LGUI &kp RCTRL>;
};
